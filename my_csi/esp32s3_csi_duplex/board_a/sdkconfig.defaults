## my_csi/esp32s3_csi_duplex/board_a/sdkconfig.defaults
```kconfig
CONFIG_IDF_TARGET="esp32s3"
CONFIG_ESP_WIFI_CSI_ENABLED=y
CONFIG_CSI_BOARD_A=y
CONFIG_CSI_CHANNEL=6
CONFIG_CSI_CYCLE_MS=100
CONFIG_CSI_REPLY_WAIT_MS=80
CONFIG_CSI_REPLY_DELAY_MS=5
CONFIG_FREERTOS_HZ=1000
CONFIG_ESP_CONSOLE_UART_BAUDRATE=115200
```

## my_csi/esp32s3_csi_duplex/board_b/main/Kconfig.projbuild
```kconfig
menu "CSI pair settings"

    choice CSI_BOARD
        prompt "Board identity"
        default CSI_BOARD_A
        help
            Flash one board as A and the other as B. Both transmit and receive.

        config CSI_BOARD_A
            bool "Board A (starts request/reply cycles)"

        config CSI_BOARD_B
            bool "Board B (replies to A)"
    endchoice

    config CSI_CHANNEL
        int "Wi-Fi channel (must match on both boards)"
        range 1 11
        default 6

    config CSI_CYCLE_MS
        int "Request/reply cycle period in milliseconds (Board A)"
        range 20 5000
        default 100
        help
            100 ms targets 10 packets per second in each direction.
            Shorter periods may require a higher serial console baud rate.
            This is a target period; scheduling and lost packets affect timing.

    config CSI_REPLY_WAIT_MS
        int "Application reply timeout in milliseconds (Board A)"
        range 20 2000
        default 80

    config CSI_REPLY_DELAY_MS
        int "Delay before replying in milliseconds (Board B)"
        range 1 1000
        default 5

endmenu
```

## my_csi/esp32s3_csi_three_board/board_c/main/Kconfig.projbuild
```kconfig
menu "CSI three-board settings"

    choice CSI_BOARD
        prompt "Board identity"
        default CSI_BOARD_A

        config CSI_BOARD_A
            bool "Board A (coordinator, transmitter and receiver)"

        config CSI_BOARD_B
            bool "Board B (transmitter and receiver)"

        config CSI_BOARD_C
            bool "Board C (transmitter and receiver)"
    endchoice

    config CSI_CHANNEL
        int "Wi-Fi channel (match on all three boards)"
        range 1 11
        default 6

    config CSI_TURN_MS
        int "Duration of each transmitting turn in milliseconds"
        range 20 5000
        default 20
        help
            The default is 20 ms per turn and approximately 60 ms for A+B+C.
            Each directed link is measured about 16.67 times per second; each
            board receives about 33.33 CSI records per second from its two peers.
            Use the same timing on all boards. The packaged UART console uses
            460800 baud to carry the extra raw CSI rows. Radio delays can extend
            turns; this is not a hard real-time synchronization protocol.

    config CSI_REPLY_DELAY_MS
        int "Delay after receiving a turn grant in milliseconds"
        range 1 10
        default 2

endmenu
```

## my_csi/esp32s3_csi_three_board/board_c/sdkconfig.defaults
```kconfig
CONFIG_IDF_TARGET="esp32s3"
CONFIG_ESP_WIFI_CSI_ENABLED=y
CONFIG_CSI_BOARD_C=y
CONFIG_CSI_CHANNEL=6
CONFIG_CSI_TURN_MS=20
CONFIG_CSI_REPLY_DELAY_MS=2
CONFIG_FREERTOS_HZ=1000
CONFIG_ESP_CONSOLE_UART_BAUDRATE=460800
```
